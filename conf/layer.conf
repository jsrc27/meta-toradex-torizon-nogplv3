## conf/layer.conf
```bitbake
# We have a conf and classes directory, add to BBPATH
BBPATH .= ":${LAYERDIR}"

# We have recipes-* directories, add to BBFILES
BBFILES += "${LAYERDIR}/recipes-*/*/*.bb \
            ${LAYERDIR}/recipes-*/*/*.bbappend"

BBFILE_COLLECTIONS += "meta-toradex-torizon-nogplv3"
BBFILE_PATTERN_meta-toradex-torizon-nogplv3 = "^${LAYERDIR}/"
BBFILE_PRIORITY_meta-toradex-torizon-nogplv3 = "99"

LAYERDEPENDS_meta-toradex-torizon-nogplv3 = "meta-toradex-torizon"
LAYERSERIES_COMPAT_meta-toradex-torizon-nogplv3 = "scarthgap"
```
